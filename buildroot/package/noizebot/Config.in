## buildroot/package/noizebot/Config.in
```kconfig
config BR2_PACKAGE_NOIZEBOT
	bool "noizebot"
	help
		noizebot dependencies
	select BR2_PACKAGE_PYTHON_GPIOZERO
	select BR2_PACKAGE_PYTHON_RPI_WS281X
```
